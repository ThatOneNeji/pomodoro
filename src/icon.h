/**
 * @file icon.h
 * @brief Icon type wrapping the pre-rasterized bitmap variants generated by scripts/gen_assets.py.
 */
#ifndef ICON_H
#define ICON_H

#include <Arduino.h>
#include "esp_log.h"

/// One concrete bitmap of an Icon, picked out at a specific pixel size.
class ScaledIcon {
   public:
    /**
     * @brief Wrap a bitmap and the pixel size it was rasterized at.
     * @param data Raw bitmap data, in the format expected by `display.drawBitmap()`.
     * @param size Width/height in pixels (icons are always square).
     */
    ScaledIcon(const unsigned char *data, uint16_t size) : data(data), size(size) {}

    const unsigned char *data;  ///< Raw bitmap data.
    uint16_t size;              ///< Width/height in pixels.
};

/**
 * @brief A square icon pre-rasterized at up to four fixed sizes.
 *
 * Bitmaps are generated ahead of time by scripts/gen_assets.py, since the ESP32 has no runtime
 * image scaling, and only at the sizes assets/manifest.json lists for that icon (each size costs
 * flash). Sizes that weren't generated are nullptr; scaled() picks the matching bitmap.
 */
class Icon {
   public:
    /**
     * @brief Wrap the pre-rasterized bitmap variants of one icon.
     * @param icon192 Bitmap at 192x192px, or nullptr if not generated.
     * @param icon128 Bitmap at 128x128px, or nullptr if not generated.
     * @param icon64 Bitmap at 64x64px, or nullptr if not generated.
     * @param icon48 Bitmap at 48x48px, or nullptr if not generated.
     */
    Icon(const unsigned char *icon192, const unsigned char *icon128, const unsigned char *icon64,
         const unsigned char *icon48)
        : icon192(icon192), icon128(icon128), icon64(icon64), icon48(icon48) {}

    const unsigned char *icon192;  ///< Bitmap at 192x192px, or nullptr.
    const unsigned char *icon128;  ///< Bitmap at 128x128px, or nullptr.
    const unsigned char *icon64;   ///< Bitmap at 64x64px, or nullptr.
    const unsigned char *icon48;   ///< Bitmap at 48x48px, or nullptr.

    /**
     * @brief Look up the pre-rasterized bitmap for a given size.
     *
     * If that size wasn't generated (a missing entry in assets/manifest.json), falls back to the
     * closest generated size and logs a warning, so the mistake shows on the serial console
     * rather than as a crash. The returned ScaledIcon::size is always the bitmap's real size.
     * @param size One of 192, 128, 64, or 48.
     * @return The matching (or closest available) ScaledIcon.
     */
    ScaledIcon scaled(uint16_t size) {
        const ScaledIcon variants[] = {ScaledIcon(icon192, 192), ScaledIcon(icon128, 128), ScaledIcon(icon64, 64),
                                       ScaledIcon(icon48, 48)};
        const ScaledIcon *closest = nullptr;
        for (const auto &variant : variants) {
            if (variant.data == nullptr) {
                continue;
            }
            if (variant.size == size) {
                return variant;
            }
            if (closest == nullptr || abs(variant.size - size) < abs(closest->size - size)) {
                closest = &variant;
            }
        }

        if (closest == nullptr) {
            ESP_LOGE("ICON", "scaled(%u): icon has no bitmaps at all", size);
            return ScaledIcon(nullptr, 0);
        }
        ESP_LOGW("ICON", "scaled(%u): size not generated (see assets/manifest.json), using %u", size, closest->size);
        return *closest;
    }
};

#endif  // ICON_H